## boards/shields/corne42/Kconfig.defconfig
```kconfig
if SHIELD_CORNE42_LEFT || SHIELD_CORNE42_RIGHT

config ZMK_KEYBOARD_NAME
	default "Corne"

config ZMK_SPLIT
	default y

endif

if SHIELD_CORNE42_LEFT

config ZMK_SPLIT_ROLE_CENTRAL
	default y

endif
```
