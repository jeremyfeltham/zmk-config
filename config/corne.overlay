&kscan0 {
    diode-direction = "row2col";

    row-gpios
        = <&gpio0 22 GPIO_ACTIVE_HIGH> // Physical Label 22 (Top Row)
        , <&gpio0 24 GPIO_ACTIVE_HIGH> // Physical Label 24 (Middle Row)
        , <&gpio1 0  GPIO_ACTIVE_HIGH> // Physical Label 100 (Bottom Row)
        , <&gpio0 20 GPIO_ACTIVE_HIGH> // Physical Label 20 (Thumb Cluster)
        ;
};
